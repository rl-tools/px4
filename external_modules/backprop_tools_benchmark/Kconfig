## external_modules/backprop_tools_benchmark/Kconfig
```kconfig
menuconfig EXAMPLES_BACKPROP_TOOLS_BENCHMARK
	bool "backprop_tools_benchmark"
	default n
	---help---
		Enable support for BackpropTools Benchmark
```

## external_modules/src/modules/rl_tools_benchmark/Kconfig
```kconfig
menuconfig MODULES_BACKPROP_TOOLS_BENCHMARK
	bool "rl_tools_benchmark"
	default n
	---help---
		Enable support for RLtools Benchmark
```
